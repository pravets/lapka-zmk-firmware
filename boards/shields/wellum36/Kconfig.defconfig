## boards/shields/wellum36/Kconfig.defconfig
```kconfig
if SHIELD_WELLUM36_DONGLE

config ZMK_KEYBOARD_NAME
	default "Lapka"

config ZMK_USB
	default y

config ZMK_STUDIO
  default y

config ZMK_SPLIT_BLE_ROLE_CENTRAL
	default y

config ZMK_SPLIT_BLE_CENTRAL_PERIPHERALS
  default 2

config BT_MAX_CONN
  default 4

config BT_MAX_PAIRED
  default 4

if ZMK_DISPLAY

config I2C
    default y

config SSD1306
    default y

choice ZMK_DISPLAY_WORK_QUEUE
    default ZMK_DISPLAY_WORK_QUEUE_DEDICATED
endchoice

endif

if LVGL

config LV_Z_VDB_SIZE
    default 64

config LV_DPI_DEF
    default 148

config LV_Z_BITS_PER_PIXEL
    default 1

choice LV_COLOR_DEPTH
    default LV_COLOR_DEPTH_1
endchoice

endif

endif

if SHIELD_WELLUM36_LEFT || SHIELD_WELLUM36_RIGHT || SHIELD_WELLUM36_DONGLE

config ZMK_SPLIT
	default y

config ZMK_BLE
	default y

endif
```

## config/west.yml
```yaml
manifest:
  remotes:
    - name: zmkfirmware
      url-base: https://github.com/zmkfirmware
    - name: crazy-keyboards
      url-base: https://github.com/crazy-keyboards
    - name: englmaxi
      url-base: https://github.com/englmaxi
  projects:
    - name: zmk
      remote: zmkfirmware
      revision: main
      import: app/west.yml
    - name: zmk-locales
      remote: crazy-keyboards
      revision: develop
    - name: zmk-dongle-display
      remote: englmaxi
      revision: main
  self:
    path: config
```
